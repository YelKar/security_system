#include "Arduino.h"
#include "EspMQTTClient.h"

#define TXD 1                   //пин подключнеия дачика
bool x;                         //создаём переменную для данных с дачика
bool y;                         //создаём промежуточную переменную для проверки обнавлений данных дачика

EspMQTTClient client(
  "ssid",                   //слово ssid заменить на ssid вашего wifi(Кавычки(") не трогать!!!)
  "password",               //слово password заменить на пароль вашего wifi(Кавычки(") не трогать!!!)
  
  "dev.rightech.io",        //эту строку не трогать!!!
  "MQTT_indifikator"        //Фразу MQTT_indifikator заменить на индификатор mqtt объекта(Кавычки(") не трогать!!!)
);

void setup() {
  pinMode(TXD, INPUT);     //инициируем пин дачика на получение данных
}

void onConnectionEstablished(){}        //в этой функции получаем данные с сервера. Так ка в данном поекте мы не получаем данных то она у нас пустая

void publishTemperature(){                                     //в этой функции передаём данные на сервер
  if (client.isConnected()){                                   //проверяем на связи ли сервер
    client.publish("topic", String(x));                        //отправляем данные дачика серверу(слово toic заменить на название MQTT топика в который идёт публикация)
  }
}

void loop() {
  client.loop();                  //строчку не трогать!!!
  
  if(digitalRead(TXD)){           //если от дачика получен высокий сигнал
    x = true;                     //записываем данные в переменную
  }
  else if(!digitalRead(TXD)){     //если от дачика получен низкий сигнал
    x = false;                    //записываем данные в переменную
  }
  
  if(y != x){                     //если значение дачика изменилось
    publishTemperature();         //вызываем функцию отправки данных
    y = x;                        //запоминаем новое значение для дальнейшего сравнивания
  }
}
